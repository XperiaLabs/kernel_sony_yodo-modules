## joystick/aks/kernel/aks_js_drivers/aks-adc-joystick/Kconfig
```kconfig
# SPDX-License-Identifier: GPL-2.0-only

config AKS_ADC_JOYSTICK
	tristate "AKS input driver"
	depends on IIO
	select IIO_BUFFER_CB
	help
	  Say Y here if you have a aks input driver.

	  To compile this driver as a module, choose M here: the
	  module will be called aks-input.
```

## joystick/aks/kernel/drivers/input/joystick/aks/Kconfig
```kconfig
config AKS_JOYSTICK_HYPERION
	tristate "Texas Instruments ADS1015 ADC configurated for AKS Joystick driver"
	depends on I2C
	select REGMAP_I2C
	select IIO_BUFFER
	select IIO_TRIGGERED_BUFFER
	help
	  If you say yes here you get support for Texas Instruments ADS1015
	  ADC chip.

	  This driver can also be built as a module. If so, the module will be
	  called ti-ads1015.
```

## qcom/ecosw/joystick/aks/kernel/aks_js_drivers/aks-ads1015/Kconfig
```kconfig
# SPDX-License-Identifier: GPL-2.0-only

config CONFIG_AKS_ADS1015
	tristate "Texas Instruments ADS1015 ADC as AKSys joystick"
	depends on I2C
	select REGMAP_I2C
	select IIO_BUFFER
	select IIO_TRIGGERED_BUFFER
	help
	  If you say yes here you get support for Texas Instruments ADS1015
	  ADC chip that adjusted for AKSys joystick

	  This driver can also be built as a module. If so, the module will be
	  called ti-ads1015.
```
